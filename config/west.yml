## config/west.yml
```yaml
manifest:
  defaults:
    revision: main
  remotes:
    - name: zmkfirmware
      url-base: https://github.com/zmkfirmware
  projects:
    - name: zmk
      remote: zmkfirmware
      import: app/west.yml
    - name: the-blob
      url: https://github.com/dapetcu21/the-blob-zmk-module
  self:
    path: config
```
